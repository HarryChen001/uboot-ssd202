## configs/infinity2m_spinand_defconfig
```kconfig
CONFIG_ARM=y
CONFIG_INFINITY2M=y
CONFIG_CMD_BOOTLOGO=y
CONFIG_CMD_TFTPPUT=y
CONFIG_CMD_DHCP=y
CONFIG_CMD_PING=y
CONFIG_CMD_USBSTART=y
CONFIG_CMD_CUSTOMER_INIT=y
CONFIG_SILENT_CONSOLE=y
CONFIG_NET=y
CONFIG_HW_WATCHDOG=y
CONFIG_USB=y
CONFIG_USB_STORAGE=y
CONFIG_MSTAR_DRIVERS=y
CONFIG_MS_ISP_FLASH=y
CONFIG_MS_PARTITION=y
CONFIG_MS_SDMMC=y
CONFIG_MS_SAVE_ENV_IN_NAND_FLASH=y
CONFIG_MS_USB=y
CONFIG_MS_EMAC=y
CONFIG_ETHERNET_ALBANY=y
CONFIG_ENABLE_FIRST_EHC=y
CONFIG_ENABLE_SECOND_EHC=y
CONFIG_MS_AESDMA=y
CONFIG_MS_SPINAND=y
CONFIG_MS_SPINAND_QUAD_READ=y
CONFIG_MS_SPINAND_QUAD_WRITE=y
CONFIG_IMAGE_POSTFIX="_spinand"
CONFIG_SSTAR_DISP=y
CONFIG_SSTAR_PNL=y
CONFIG_SSTAR_JPD=y
CONFIG_SSTAR_MSPI=y
CONFIG_SSTAR_SAR=y
CONFIG_SSTAR_WDT=y
CONFIG_SSTAR_PWM=y
```
